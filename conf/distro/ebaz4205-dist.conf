## conf/distro/ebaz4205-dist.conf
```bitbake
require conf/distro/poky.conf

DISTRO = "ebaz4205-dist"
DISTRO_NAME = "EBAZ4205 Distro"
DISTRO_VERSION = "1.0"

DISTRO_FEATURES_append = " systemd"
VIRTUAL-RUNTIME_init_manager = "systemd"
DISTRO_FEATURES_BACKFILL_CONSIDERED = "sysvinit"

PACKAGE_CLASSES = "package_ipk"

VIRTUAL-RUNTIME_dev_manager = "udev"

PREFERRED_PROVIDER_virtual/kernel := "linux-xlnx"
PREFERRED_VERSION_linux-xlnx := "4.19%"
```

## conf/layer.conf
```bitbake
# We have a conf and classes directory, add to BBPATH
BBPATH .= ":${LAYERDIR}"

# We have recipes-* directories, add to BBFILES
BBFILES += "${LAYERDIR}/recipes-*/*/*.bb \
            ${LAYERDIR}/recipes-*/*/*.bbappend"

BBFILE_COLLECTIONS += "meta-ebaz4205"
BBFILE_PATTERN_meta-ebaz4205 = "^${LAYERDIR}/"
BBFILE_PRIORITY_meta-ebaz4205 = "8"

LAYERDEPENDS_meta-embedme = "core xilinx xilinx-tools"
LAYERSERIES_COMPAT_meta-ebaz4205 = "warrior zeus"

# Temporary fix for Xilinx bug
# https://github.com/Xilinx/meta-xilinx-tools/pull/28
XILINX_VER_MAIN = "2020.1"
```

## conf/machine/ebaz4205-zynq7.conf
```bitbake
#@TYPE: Machine
#@NAME: ebaz4205-zynq7
#@DESCRIPTION: Machine support for EBAZ4205.
#
# For details on the EBAZ4205 board:
#     https://embed-me.com/ebaz4205-recycle-a-cheap-crypto-miner-part-1/
#

SOC_VARIANT ?= "7z"

require conf/machine/include/tune-zynq.inc
require conf/machine/include/machine-xilinx-overrides.inc
require conf/machine/include/machine-xilinx-default.inc

MACHINE_FEATURES = "ext2 vfat"

PREFERRED_PROVIDER_virtual/bootloader = "u-boot"
PREFERRED_PROVIDER_virtual/boot-bin = "xilinx-bootbin"
UBOOT_MACHINE = "zynq_ebaz4205_config"
SPL_BINARY ?= "spl/boot.bin"
UBOOT_ELF_zynq = "u-boot"

EXTRA_IMAGEDEPENDS += " \
		u-boot-zynq-uenv \
		virtual/boot-bin \
		virtual/bootloader \
		u-boot-zynq-scr \
		"

SERIAL_CONSOLE = "115200 ttyPS0"

# Force yocto to use our device-tree
BBMASK += "/meta-xilinx-tools/recipes-bsp/device-tree"
MACHINE_ESSENTIAL_EXTRA_RDEPENDS += "device-tree"

IMAGE_FSTYPES = "cpio cpio.gz.u-boot cpio.gz"

IMAGE_BOOT_FILES += " \
		boot.bin \
		uEnv.txt \
		"
```
